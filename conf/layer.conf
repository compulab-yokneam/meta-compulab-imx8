## conf/layer.conf
```bitbake
# We have a conf and classes directory, append to BBPATH
BBPATH .= ":${LAYERDIR}"

# We have a recipes directory containing .bb and .bbappend files, add to BBFILES
BBFILES += "${LAYERDIR}/recipes*/*/*.bb \
            ${LAYERDIR}/recipes*/*/*.bbappend"

BBFILE_COLLECTIONS += "compulab"
BBFILE_PATTERN_compulab := "^${LAYERDIR}/"
BBFILE_PRIORITY_compulab = "9"
```

## conf/machine/cl-som-imx8.conf
```bitbake
#@TYPE: Machine
#@NAME: CompuLab i.MX8MQ Evaluation Kit
#@SOC: i.MX8MQ
#@DESCRIPTION: Machine configuration for CompuLab i.MX8MQ EVK
#@MAINTAINER: CompuLab <compulab@compulab.com>

require conf/machine/include/arm/arch-arm64.inc
require conf/machine/include/imx-base.inc

MACHINE_FEATURES += " pci wifi bluetooth"

MACHINEOVERRIDES =. "mx8:mx8mq:"

PREFERRED_PROVIDER_virtual/bootloader_cl-som-imx8 = "u-boot-imx"

MACHINE_SOCARCH_FILTER_append_cl-som-imx8 = "virtual/libopenvg virtual/libgles1 virtual/libgles2 virtual/egl virtual/mesa virtual/libgl virtual/libg2d"

KERNEL_DEVICETREE = "compulab/cl-som-imx8.dtb compulab/cl-som-imx8-4k.dtb"
KERNEL_DEVICETREE += "compulab/cl-som-imx8-lvds-dcss.dtb compulab/cl-som-imx8-lvds-lcdif.dtb compulab/cl-som-imx8-dual.dtb"
KERNEL_DEVICETREE += "compulab/cl-som-imx8-csi.dtb"

UBOOT_CONFIG ??= "sd"
UBOOT_CONFIG[sd] = "cl-som-imx8_defconfig,sdcard"
UBOOT_CONFIG[mfgtool] = "cl-som-imx8_defconfig"
SPL_BINARY = "spl/u-boot-spl.bin"

# Set DDR FIRMWARE
DDR_FIRMWARE_NAME = "lpddr4_pmu_train_1d_imem.bin lpddr4_pmu_train_1d_dmem.bin lpddr4_pmu_train_2d_imem.bin lpddr4_pmu_train_2d_dmem.bin"

# Set u-boot DTB
UBOOT_DTB_NAME = "cl-som-imx8.dtb"

# Set imx-mkimage boot target
IMXBOOT_TARGETS = "flash_evk flash_evk_no_hdmi"

# Set Serial console
SERIAL_CONSOLE = "115200 ttymxc2"

IMAGE_BOOTLOADER = "imx-boot"

SDCARD_GENERATION_COMMAND_cl-som-imx8 = "generate_imx_sdcard"

DEFAULTTUNE_cl-som-imx8 = "aarch64"

IMX_DEFAULT_KERNEL_cl-som-imx8 = "linux-imx"

BOOT_SPACE = "32768"

KERNEL_IMAGETYPE = "Image"
LOADADDR = ""
UBOOT_SUFFIX = "bin"
UBOOT_MAKE_TARGET = ""
IMX_BOOT_SEEK = "33"

IMAGE_FSTYPES = "sdcard.xz tar.xz"
```
